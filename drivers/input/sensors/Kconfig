## drivers/input/sensors/Kconfig
```kconfig
# SPDX-License-Identifier: GPL-2.0-only
#
# Input sensor driver configuration
#

menuconfig INPUT_SENSORS
	bool "Sensors"
	help
	  Say Y here, and a list of supported sensors will be displayed.
	  This option doesn't affect the kernel.

	  If unsure, say Y.

if INPUT_SENSORS

source "drivers/input/sensors/hall/Kconfig"
source "drivers/input/sensors/fingerprint/Kconfig"

endif
```

## drivers/input/sensors/hall/Kconfig
```kconfig
# SPDX-License-Identifier: GPL-2.0-only
#
# Hall sensor driver configuration
#

config HS_MH248_FYDE
	tristate "MH248 Hall sensor for Fyde devices"
	depends on OF && GPIOLIB
	help
	  Say Y here if you want to enable support for MH248 hall sensor
	  on Fyde devices. This driver provides lid switch functionality
	  for ChromeOS devices.

	  To compile this driver as a module, choose M here: the
	  module will be called mh248-fyde.
```

## drivers/media/platform/rockchip/Kconfig
```kconfig
# SPDX-License-Identifier: GPL-2.0-only

comment "Rockchip media platform drivers"

config VIDEO_RK3588_AV1_DEC
	tristate "Rockchip RK3588 AV1 Video Decoder"
	depends on VIDEO_DEV && VIDEO_V4L2_SUBDEV_API
	depends on ARCH_ROCKCHIP || COMPILE_TEST
	select VIDEOBUF2_DMA_CONTIG
	select V4L2_MEM2MEM_DEV
	help
	  Support for the Rockchip RK3588 AV1 hardware video decoder.
	  This is a V4L2 stateless decoder driver that uses the VDPU383
	  hardware accelerator. Based on Rockchip MPP architecture.

	  To compile this driver as a module, choose M here: the module
	  will be called rk3588-av1-dec.

source "drivers/media/platform/rockchip/rga/Kconfig"
source "drivers/media/platform/rockchip/rkisp1/Kconfig"
```

## drivers/soc/rockchip/Kconfig
```kconfig
# SPDX-License-Identifier: GPL-2.0-only
if ARCH_ROCKCHIP || COMPILE_TEST

source "drivers/soc/rockchip/Kconfig.cpu"

#
# Rockchip Soc drivers
#

config ROCKCHIP_GRF
	bool "Rockchip General Register Files support" if COMPILE_TEST
	default y if ARCH_ROCKCHIP
	help
	  The General Register Files are a central component providing
	  special additional settings registers for a lot of soc-components.
	  In a lot of cases there also need to be default settings initialized
	  to make some of them conform to expectations of the kernel.

config ROCKCHIP_IODOMAIN
	tristate "Rockchip IO domain support"
	depends on OF
	help
	  Say y here to enable support io domains on Rockchip SoCs. It is
	  necessary for the io domain setting of the SoC to match the
	  voltage supplied by the regulators.

config ROCKCHIP_DTPM
	tristate "Rockchip DTPM hierarchy"
	depends on DTPM && m
	help
	  Describe the hierarchy for the Dynamic Thermal Power Management tree
	  on this platform. That will create all the power capping capable
	  devices.

config ROCKCHIP_SUSPEND_MODE
  tristate "Rockchip suspend mode config"
  help
    Say Y here if you want to set the suspend mode to the ATF.

config ROCKCHIP_CPUINFO
	tristate "Rockchip cpuinfo support"
	depends on (NVMEM_ROCKCHIP_EFUSE || NVMEM_ROCKCHIP_OTP) && (ARM64 || ARM)
	help
	  Say y here to enable Rockchip cpuinfo support.
	  Set system_serial_low/high from eFuse ID.
	  Serial can read from /proc/cpuinfo.

	  If unsure, say N.

config ROCKCHIP_VENDOR_STORAGE
  tristate "Rockchip vendor storage support"
  help
    Say y here to enable rockchip vendor storage support.

config ROCKCHIP_MMC_VENDOR_STORAGE
  tristate "Rockchip mmc vendor storage support"
  depends on ROCKCHIP_VENDOR_STORAGE && MMC
  help
    Say y here to enable rockchip mmc vendor storage support.

config ROCKCHIP_MTD_VENDOR_STORAGE
  tristate "Rockchip mtd vendor storage support"
  depends on ROCKCHIP_VENDOR_STORAGE && MTD
  help
    Say y here to enable rockchip mtd vendor storage support.

config ROCKCHIP_OPP
	tristate "Rockchip OPP select support"
	depends on PM_DEVFREQ
	help
	  Say y here to enable rockchip OPP support.

config ROCKCHIP_PVTM
	tristate "Rockchip PVTM support"
	help
	  Say y here to enable pvtm support.
	  The Process-Voltage-Temperature Monitor (PVTM) is used to monitor
	  the chip performance variance caused by chip process, voltage and
	  temperature.

config ROCKCHIP_DEBUG
	tristate "Rockchip DEBUG"
	help
	  Print dbgpcsr for every cpu when panic.

config ROCKCHIP_SYSTEM_MONITOR
	tristate "Rockchip system monitor support"
	depends on THERMAL && PM_DEVFREQ
	help
	  Say y here to enable rockchip system monitor support.
	  Rockchip system monitor manages CPU and device frequency
	  scaling based on temperature and system status.

source "drivers/soc/rockchip/fiq_debugger/Kconfig"

endif
```
